## coreboot/src/mainboard/intel/s1200kp/Kconfig
```kconfig
## SPDX-License-Identifier: GPL-2.0-only

if BOARD_INTEL_S1200KP

config BOARD_SPECIFIC_OPTIONS
	def_bool y
	select BOARD_ROMSIZE_KB_4096
	select HAVE_ACPI_RESUME
	select HAVE_ACPI_TABLES
	select HAVE_GBE_BIN
	select HAVE_IFD_BIN
	select HAVE_ME_BIN
	select MAINBOARD_USES_IFD_GBE_REGION
	select INTEL_INT15
	select NORTHBRIDGE_INTEL_SANDYBRIDGE
	select SERIRQ_CONTINUOUS_MODE
	select SOUTHBRIDGE_INTEL_BD82X6X
	select SUPERIO_NUVOTON_NCT6776
	select USE_NATIVE_RAMINIT


config MAINBOARD_DIR
	string
	default "intel/s1200kp"

config MAINBOARD_PART_NUMBER
	string
	default "S1200KP"

config DRAM_RESET_GATE_GPIO
	int
	default 60

config USBDEBUG_HCD_INDEX
	int
	default 2

endif
```

## coreboot/src/mainboard/intel/s1200kp/Kconfig.name
```kconfig
## SPDX-License-Identifier: GPL-2.0-only

config BOARD_INTEL_S1200KP
	bool "S1200KP"
```
